#pragma once
#include <dt-bindings/zmk/keys.h>

#define J_DQT       AT                  // "
#define J_AMPS      CARET               // &
#define J_SQT       AMPERSAND           // '
#define J_EQUAL     UNDER               // =
#define J_CARET     EQUAL               // ^
#define J_YEN       0x89                // ¥
#define J_PLUS      COLON               // +
#define J_TILDE     PLUS                // ~
#define J_PIPE      LS(0x89)            // |
#define J_AT        LEFT_BRACKET        // @
#define J_COLON     SINGLE_QUOTE        // :
#define J_ASTRK     DOUBLE_QUOTES       // *
#define J_GRAVE     LEFT_BRACE          // `
#define J_UNDER     LS(0x87)            // _
#define J_LBKT      RIGHT_BRACKET       // [
#define J_RBKT      BACKSLASH           // ]
#define J_LPAR      ASTERISK            // (
#define J_RPAR      LEFT_PARENTHESIS    // )
#define J_LBRC      RIGHT_BRACE         // {
#define J_RBRC      PIPE                // }
#define J_KANA      LANGUAGE_1          // かな
#define J_EISU      LANGUAGE_2          // 英数
#define J_HANZEN    GRAVE               // 半角/全角

#define CWL         LC(LG(LEFT))        // CTRL+WIN+LEFT
#define CWR         LC(LG(RIGHT))       // CTRL+WIN+RIGHT

/* ========================================
 * レイヤー番号（keymap内の並び順と一致させること）
 * .keymap / .overlay の両方からこのファイルをincludeして使用する
 * ======================================== */
#define LAY_BASE            0   // default_layer
#define LAY_GAME            1   // GAME_MODE
#define LAY_SYMBOL          2   // SYMBOL
#define LAY_NAV             3   // NAVIGATION
#define LAY_NUMFUNC         4   // NUMBER+FUNCTION
#define LAY_SETTING         5   // Setting
#define LAY_SCROLL_R        6   // SCROLL_R
#define LAY_NORMAL_TB       7   // NORMAL_TB
#define LAY_SWAP_TB         8   // SWAP_TB
#define LAY_SLOW_TB         9   // SLOW_TB
#define LAY_SWAP_SLOW_TB   10   // SWAP_SLOW_TB
